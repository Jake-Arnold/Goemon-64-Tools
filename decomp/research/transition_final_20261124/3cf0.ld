SECTIONS { .text 0x800030F0 : { *(.text) } .rodata 0x8007A88C : SUBALIGN(4) { *(.rodata) } /DISCARD/ : { *(.reginfo) *(.MIPS.abiflags) *(.pdr) *(.comment) *(.mdebug*) } }
D_800BCCC0_BD8C0 = 0x800BCCC0;
D_8015C5C8_15D1C8 = 0x8015C5C8;
D_800548D8_554D8 = 0x800548D8;
D_801CCB7C = 0x801CCB7C;
D_3ADD6 = 0x3ADD6;
D_3ADF4 = 0x3ADF4;
func_8000383C_443C = 0x8000383C;
func_80001C00_2800 = 0x80001C00;
func_801CB460 = 0x801CB460;
func_8003488C_3548C = 0x8003488C;
func_80034734_35334 = 0x80034734;
func_80003728_4328 = 0x80003728;
jtbl_8007A88C_7B48C = 0x8007A88C;
